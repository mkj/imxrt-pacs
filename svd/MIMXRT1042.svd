# MIMXRT1042 register map
Vendor: nxp.com; File version: 1.0
CPU: CM7 r0p1, little endian, MPU, FPU, VTOR, 4 interrupt priority bits
Registers are 32-bit, read-write, reset 0x0 unless marked. A register's access mark holds for its fields unless they carry their own. Offsets are from the block's base; [hi:lo] are bit positions; {n}, {i} and the like mark numbered series.

## NVIC — Nested Vectored Interrupt Controller
Base 0xE000E100
{0x0+4i} NVICISER{i} write-1-clears (i=0..4) — Interrupt Set Enable Register n
  [31:0] SETENA write-1-clears — Interrupt set enable bits
{0x80+4i} NVICICER{i} write-1-clears (i=0..4) — Interrupt Clear Enable Register n
  [31:0] CLRENA write-1-clears — Interrupt clear-enable bits
{0x100+4i} NVICISPR{i} write-1-clears (i=0..4) — Interrupt Set Pending Register n
  [31:0] SETPEND write-1-clears — Interrupt set-pending bits
{0x180+4i} NVICICPR{i} write-1-clears (i=0..4) — Interrupt Clear Pending Register n
  [31:0] CLRPEND write-1-clears — Interrupt clear-pending bits
{0x200+4i} NVICIABR{i} (i=0..4) — Interrupt Active bit Register n
  [31:0] ACTIVE — Interrupt active flags
{0x300+i} NVICIP{i} 8-bit (i=0..15) — Interrupt Priority Register {i}
  [7:4] PRI{i} — Priority of the INT_DMA{i}_DMA{i+16} interrupt {i}
0x310 NVICIP16 8-bit — Interrupt Priority Register 16
  [7:4] PRI16 — Priority of the INT_DMA_ERROR interrupt 16
0x311 NVICIP17 8-bit — Interrupt Priority Register 17
  [7:4] PRI17 — Priority of the INT_CTI0_ERROR interrupt 17
0x312 NVICIP18 8-bit — Interrupt Priority Register 18
  [7:4] PRI18 — Priority of the INT_CTI1_ERROR interrupt 18
0x313 NVICIP19 8-bit — Interrupt Priority Register 19
  [7:4] PRI19 — Priority of the INT_CORE interrupt 19
{0x300+i} NVICIP{i} 8-bit (i=20..27) — Interrupt Priority Register {i}
  [7:4] PRI{i} — Priority of the INT_LPUART{i-19} interrupt {i}
{0x300+i} NVICIP{i} 8-bit (i=28..31) — Interrupt Priority Register {i}
  [7:4] PRI{i} — Priority of the INT_LPI2C{i-27} interrupt {i}
0x320 NVICIP32 8-bit — Interrupt Priority Register 32
  [7:4] PRI32 — Priority of the INT_LPSPI1 interrupt 32
0x321 NVICIP33 8-bit — Interrupt Priority Register 33
  [7:4] PRI33 — Priority of the INT_LPSPI2 interrupt 33
0x322 NVICIP34 8-bit — Interrupt Priority Register 34
  [7:4] PRI34 — Priority of interrupt 34
0x323 NVICIP35 8-bit — Interrupt Priority Register 35
  [7:4] PRI35 — Priority of the INT_LPSPI3 interrupt 35
0x324 NVICIP36 8-bit — Interrupt Priority Register 36
  [7:4] PRI36 — Priority of the INT_CAN1 interrupt 36
0x325 NVICIP37 8-bit — Interrupt Priority Register 37
  [7:4] PRI37 — Priority of the INT_CAN2 interrupt 37
0x326 NVICIP38 8-bit — Interrupt Priority Register 38
  [7:4] PRI38 — Priority of the INT_FLEXRAM interrupt 38
0x327 NVICIP39 8-bit — Interrupt Priority Register 39
  [7:4] PRI39 — Priority of interrupt 39
0x328 NVICIP40 8-bit — Interrupt Priority Register 40
  [7:4] PRI40 — Priority of interrupt 40
0x329 NVICIP41 8-bit — Interrupt Priority Register 41
  [7:4] PRI41 — Priority of the INT_GPR_IRQ interrupt 41
0x32A NVICIP42 8-bit — Interrupt Priority Register 42
  [7:4] PRI42 — Priority of the INT_LCDIF interrupt 42
0x32B NVICIP43 8-bit — Interrupt Priority Register 43
  [7:4] PRI43 — Priority of interrupt 43
0x32C NVICIP44 8-bit — Interrupt Priority Register 44
  [7:4] PRI44 — Priority of the INT_PXP interrupt 44
0x32D NVICIP45 8-bit — Interrupt Priority Register 45
  [7:4] PRI45 — Priority of the INT_WDOG2 interrupt 45
0x32E NVICIP46 8-bit — Interrupt Priority Register 46
  [7:4] PRI46 — Priority of the INT_SNVS_HP_WRAPPER interrupt 46
0x32F NVICIP47 8-bit — Interrupt Priority Register 47
  [7:4] PRI47 — Priority of the INT_SNVS_HP_WRAPPER_TZ interrupt 47
0x330 NVICIP48 8-bit — Interrupt Priority Register 48
  [7:4] PRI48 — Priority of the INT_SNVS_LP_WRAPPER interrupt 48
0x331 NVICIP49 8-bit — Interrupt Priority Register 49
  [7:4] PRI49 — Priority of the INT_CSU interrupt 49
0x332 NVICIP50 8-bit — Interrupt Priority Register 50
  [7:4] PRI50 — Priority of the INT_DCP interrupt 50
0x333 NVICIP51 8-bit — Interrupt Priority Register 51
  [7:4] PRI51 — Priority of the INT_DCP_VMI interrupt 51
0x334 NVICIP52 8-bit — Interrupt Priority Register 52
  [7:4] PRI52 — Priority of the INT_Reserved68 interrupt 52
0x335 NVICIP53 8-bit — Interrupt Priority Register 53
  [7:4] PRI53 — Priority of the INT_TRNG interrupt 53
0x336 NVICIP54 8-bit — Interrupt Priority Register 54
  [7:4] PRI54 — Priority of the INT_Reserved70 interrupt 54
0x337 NVICIP55 8-bit — Interrupt Priority Register 55
  [7:4] PRI55 — Priority of the INT_BEE interrupt 55
0x338 NVICIP56 8-bit — Interrupt Priority Register 56
  [7:4] PRI56 — Priority of the INT_SAI1 interrupt 56
0x339 NVICIP57 8-bit — Interrupt Priority Register 57
  [7:4] PRI57 — Priority of the INT_SAI2 interrupt 57
0x33A NVICIP58 8-bit — Interrupt Priority Register 58
  [7:4] PRI58 — Priority of the INT_SAI3_RX interrupt 58
0x33B NVICIP59 8-bit — Interrupt Priority Register 59
  [7:4] PRI59 — Priority of the INT_SAI3_TX interrupt 59
0x33C NVICIP60 8-bit — Interrupt Priority Register 60
  [7:4] PRI60 — Priority of the INT_SPDIF interrupt 60
0x33D NVICIP61 8-bit — Interrupt Priority Register 61
  [7:4] PRI61 — Priority of the INT_PMU_EVENT interrupt 61
0x33E NVICIP62 8-bit — Interrupt Priority Register 62
  [7:4] PRI62 — Priority of the INT_Reserved78 interrupt 62
0x33F NVICIP63 8-bit — Interrupt Priority Register 63
  [7:4] PRI63 — Priority of the INT_TEMP_LOW_HIGH interrupt 63
0x340 NVICIP64 8-bit — Interrupt Priority Register 64
  [7:4] PRI64 — Priority of the INT_TEMP_PANIC interrupt 64
0x341 NVICIP65 8-bit — Interrupt Priority Register 65
  [7:4] PRI65 — Priority of the INT_USB_PHY interrupt 65
0x342 NVICIP66 8-bit — Interrupt Priority Register 66
  [7:4] PRI66 — Priority of the INT_Reserved82 interrupt 66
0x343 NVICIP67 8-bit — Interrupt Priority Register 67
  [7:4] PRI67 — Priority of the INT_ADC1 interrupt 67
0x344 NVICIP68 8-bit — Interrupt Priority Register 68
  [7:4] PRI68 — Priority of the INT_ADC2 interrupt 68
0x345 NVICIP69 8-bit — Interrupt Priority Register 69
  [7:4] PRI69 — Priority of the INT_DCDC interrupt 69
0x346 NVICIP70 8-bit — Interrupt Priority Register 70
  [7:4] PRI70 — Priority of the INT_Reserved86 interrupt 70
0x347 NVICIP71 8-bit — Interrupt Priority Register 71
  [7:4] PRI71 — Priority of the INT_Reserved87 interrupt 71
{0x300+i} NVICIP{i} 8-bit (i=72..79) — Interrupt Priority Register {i}
  [7:4] PRI{i} — Priority of the INT_GPIO1_INT{i-72} interrupt {i}
0x350 NVICIP80 8-bit — Interrupt Priority Register 80
  [7:4] PRI80 — Priority of the INT_GPIO1_Combined_0_15 interrupt 80
0x351 NVICIP81 8-bit — Interrupt Priority Register 81
  [7:4] PRI81 — Priority of the INT_GPIO1_Combined_16_31 interrupt 81
0x352 NVICIP82 8-bit — Interrupt Priority Register 82
  [7:4] PRI82 — Priority of the INT_GPIO2_Combined_0_15 interrupt 82
0x353 NVICIP83 8-bit — Interrupt Priority Register 83
  [7:4] PRI83 — Priority of the INT_GPIO2_Combined_16_31 interrupt 83
0x354 NVICIP84 8-bit — Interrupt Priority Register 84
  [7:4] PRI84 — Priority of the INT_GPIO3_Combined_0_15 interrupt 84
0x355 NVICIP85 8-bit — Interrupt Priority Register 85
  [7:4] PRI85 — Priority of the INT_GPIO3_Combined_16_31 interrupt 85
0x356 NVICIP86 8-bit — Interrupt Priority Register 86
  [7:4] PRI86 — Priority of the INT_GPIO4_Combined_0_15 interrupt 86
0x357 NVICIP87 8-bit — Interrupt Priority Register 87
  [7:4] PRI87 — Priority of the INT_GPIO4_Combined_16_31 interrupt 87
0x358 NVICIP88 8-bit — Interrupt Priority Register 88
  [7:4] PRI88 — Priority of the INT_GPIO5_Combined_0_15 interrupt 88
0x359 NVICIP89 8-bit — Interrupt Priority Register 89
  [7:4] PRI89 — Priority of the INT_GPIO5_Combined_16_31 interrupt 89
0x35A NVICIP90 8-bit — Interrupt Priority Register 90
  [7:4] PRI90 — Priority of the INT_FLEXIO1 interrupt 90
0x35B NVICIP91 8-bit — Interrupt Priority Register 91
  [7:4] PRI91 — Priority of the INT_FLEXIO2 interrupt 91
0x35C NVICIP92 8-bit — Interrupt Priority Register 92
  [7:4] PRI92 — Priority of the INT_WDOG1 interrupt 92
0x35D NVICIP93 8-bit — Interrupt Priority Register 93
  [7:4] PRI93 — Priority of the INT_RTWDOG interrupt 93
0x35E NVICIP94 8-bit — Interrupt Priority Register 94
  [7:4] PRI94 — Priority of the INT_EWM interrupt 94
0x35F NVICIP95 8-bit — Interrupt Priority Register 95
  [7:4] PRI95 — Priority of the INT_CCM_1 interrupt 95
0x360 NVICIP96 8-bit — Interrupt Priority Register 96
  [7:4] PRI96 — Priority of the INT_CCM_2 interrupt 96
0x361 NVICIP97 8-bit — Interrupt Priority Register 97
  [7:4] PRI97 — Priority of the INT_GPC interrupt 97
0x362 NVICIP98 8-bit — Interrupt Priority Register 98
  [7:4] PRI98 — Priority of the INT_SRC interrupt 98
0x363 NVICIP99 8-bit — Interrupt Priority Register 99
  [7:4] PRI99 — Priority of the INT_Reserved115 interrupt 99
0x364 NVICIP100 8-bit — Interrupt Priority Register 100
  [7:4] PRI100 — Priority of the INT_GPT1 interrupt 100
0x365 NVICIP101 8-bit — Interrupt Priority Register 101
  [7:4] PRI101 — Priority of the INT_GPT2 interrupt 101
{0x300+i} NVICIP{i} 8-bit (i=102..105) — Interrupt Priority Register {i}
  [7:4] PRI{i} — Priority of the INT_PWM1_{i-102} interrupt {i}
0x36A NVICIP106 8-bit — Interrupt Priority Register 106
  [7:4] PRI106 — Priority of the INT_PWM1_FAULT interrupt 106
0x36B NVICIP107 8-bit — Interrupt Priority Register 107
  [7:4] PRI107 — Priority of the INT_FLEXSPI2 interrupt 107
0x36C NVICIP108 8-bit — Interrupt Priority Register 108
  [7:4] PRI108 — Priority of interrupt 108
0x36D NVICIP109 8-bit — Interrupt Priority Register 109
  [7:4] PRI109 — Priority of the INT_SEMC interrupt 109
0x36E NVICIP110 8-bit — Interrupt Priority Register 110
  [7:4] PRI110 — Priority of the INT_USDHC1 interrupt 110
0x36F NVICIP111 8-bit — Interrupt Priority Register 111
  [7:4] PRI111 — Priority of the INT_USDHC2 interrupt 111
0x370 NVICIP112 8-bit — Interrupt Priority Register 112
  [7:4] PRI112 — Priority of the INT_Reserved112 interrupt 112
0x371 NVICIP113 8-bit — Interrupt Priority Register 113
  [7:4] PRI113 — Priority of the INT_USB_OTG interrupt 113
0x372 NVICIP114 8-bit — Interrupt Priority Register 114
  [7:4] PRI114 — Priority of the INT_ENET interrupt 114
0x373 NVICIP115 8-bit — Interrupt Priority Register 115
  [7:4] PRI115 — Priority of the INT_ENET_1588_Timer interrupt 115
0x374 NVICIP116 8-bit — Interrupt Priority Register 116
  [7:4] PRI116 — Priority of the INT_XBAR1_IRQ_0_1 interrupt 116
0x375 NVICIP117 8-bit — Interrupt Priority Register 117
  [7:4] PRI117 — Priority of the INT_XBAR1_IRQ_2_3 interrupt 117
{0x300+i} NVICIP{i} 8-bit (i=118..120) — Interrupt Priority Register {i}
  [7:4] PRI{i} — Priority of the INT_ADC_ETC_IRQ{i-118} interrupt {i}
0x379 NVICIP121 8-bit — Interrupt Priority Register 121
  [7:4] PRI121 — Priority of the INT_ADC_ETC_ERROR_IRQ interrupt 121
0x37A NVICIP122 8-bit — Interrupt Priority Register 122
  [7:4] PRI122 — Priority of the INT_PIT interrupt 122
{0x300+i} NVICIP{i} 8-bit (i=123..126) — Interrupt Priority Register {i}
  [7:4] PRI{i} — Priority of the INT_ACMP{i-122} interrupt {i}
0x37F NVICIP127 8-bit — Interrupt Priority Register 127
  [7:4] PRI127 — Priority of the INT_Reserved143 interrupt 127
0x380 NVICIP128 8-bit — Interrupt Priority Register 128
  [7:4] PRI128 — Priority of the INT_Reserved144 interrupt 128
{0x300+i} NVICIP{i} 8-bit (i=129..132) — Interrupt Priority Register {i}
  [7:4] PRI{i} — Priority of the INT_ENC{i-128} interrupt {i}
{0x300+i} NVICIP{i} 8-bit (i=133..136) — Interrupt Priority Register {i}
  [7:4] PRI{i} — Priority of the INT_TMR{i-132} interrupt {i}
{0x300+i} NVICIP{i} 8-bit (i=137..140) — Interrupt Priority Register {i}
  [7:4] PRI{i} — Priority of the INT_PWM2_{i-137} interrupt {i}
0x38D NVICIP141 8-bit — Interrupt Priority Register 141
  [7:4] PRI141 — Priority of the INT_PWM2_FAULT interrupt 141
{0x300+i} NVICIP{i} 8-bit (i=142..145) — Interrupt Priority Register {i}
  [7:4] PRI{i} — Priority of the INT_PWM3_{i-142} interrupt {i}
0x392 NVICIP146 8-bit — Interrupt Priority Register 146
  [7:4] PRI146 — Priority of the INT_PWM3_FAULT interrupt 146
{0x300+i} NVICIP{i} 8-bit (i=147..150) — Interrupt Priority Register {i}
  [7:4] PRI{i} — Priority of the INT_PWM4_{i-147} interrupt {i}
0x397 NVICIP151 8-bit — Interrupt Priority Register 151
  [7:4] PRI151 — Priority of the INT_PWM4_FAULT interrupt 151
0x398 NVICIP152 8-bit — Interrupt Priority Register 152
  [7:4] PRI152 — Priority of interrupt 152
0x399 NVICIP153 8-bit — Interrupt Priority Register 153
  [7:4] PRI153 — Priority of interrupt 153
0x39A NVICIP154 8-bit — Interrupt Priority Register 154
  [7:4] PRI154 — Priority of the INT_CAN3 interrupt 154
0x39B NVICIP155 8-bit — Interrupt Priority Register 155
  [7:4] PRI155 — Priority of the INT_Reserved171 interrupt 155
0x39C NVICIP156 8-bit — Interrupt Priority Register 156
  [7:4] PRI156 — Priority of the INT_FLEXIO3 interrupt 156
0x39D NVICIP157 8-bit — Interrupt Priority Register 157
  [7:4] PRI157 — Priority of the INT_GPIO6_7_8_9 interrupt 157
0xE00 NVICSTIR — Software Trigger Interrupt Register
  [8:0] INTID — Interrupt ID of the interrupt to trigger, in the range 0-239. For example, a value of 0x03 specifies interrupt IRQ3.
