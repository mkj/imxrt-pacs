# MIMXRT1011 register map
Vendor: nxp.com; File version: 1.0
MIMXRT1011DAE5A
CPU: CM7 r0p1, little endian, MPU, FPU, VTOR, 4 interrupt priority bits
Registers are 32-bit, read-write, reset 0x0 unless marked. A register's access mark holds for its fields unless they carry their own. Offsets are from the block's base; lines under a group give offsets from that group; [hi:lo] are bit positions; {n}, {i} and the like mark numbered series; 'fields as' and 'values as' point back to an identical list; <NAME> marks a mode.

## Memory map
0x4007C000 AIPSTZ1 size 0x54 — AIPSTZ Control Registers
0x40080000 DCDC size 0x1000
0x40084000 PIT size 0x140
0x40088000 ADC_ETC size 0x150
0x40094000 AOI size 0x10 — AND/OR/INVERT module
0x40098000 XBARA size 0x88 — Crossbar Switch
0x400A0000 FLEXSPI size 0x400
0x400A0000 OTFAD size 0xDE0
0x400A4000 IOMUXC_SNVS_GPR size 0x10 — IOMUXC
0x400A8000 IOMUXC_SNVS size 0x14
0x400AC000 IOMUXC_GPR size 0x78
0x400B0000 FLEXRAM size 0x1000
0x400B4000 EWM size 0x6
0x400B8000 WDOG1 size 0xA — WDOG
0x400BC000 RTWDOG size 0x10 — WDOG
0x400C0000 GPIO5 size 0x90 — GPIO
0x400C4000 ADC1 size 0x5C — Analog-to-Digital Converter
0x400CC000 TRNG size 0xFF
0x400D0000 WDOG2 size 0xA — WDOG
0x400D4000 SNVS size 0x1000
0x400D8000 CCM_ANALOG size 0x180
0x400D8000 PMU size 0x180
0x400D8000 TEMPMON size 0x2A0 — Temperature Monitor
0x400D8000 USB_ANALOG size 0x264
0x400D8000 XTALOSC24M size 0x2D0
0x400D9000 USBPHY size 0x84 — USBPHY Register Reference Index
0x400DC000 CSU size 0x35C — CSU registers
0x400E4000 USB size 0x1E0
0x400E4000 USBNC size 0x81C — USB
0x400E8000 DMA0 size 0x1200 — DMA
0x400EC000 DMAMUX size 0x40
0x400F0000 DCP size 0x434 — DCP register reference index
0x400F4000 GPC size 0x3C
0x400F4000 PGC size 0x2B0
0x400F8000 SRC size 0x48
0x400FC000 CCM size 0x8C
0x4017C000 AIPSTZ2 size 0x54 — AIPSTZ Control Registers
0x40184000 LPUART1 size 0x30 — LPUART
0x40188000 LPUART2 size 0x30 — LPUART
0x4018C000 LPUART3 size 0x30 — LPUART
0x40190000 LPUART4 size 0x30 — LPUART
0x40194000 LPSPI1 size 0x78 — LPSPI
0x40198000 LPSPI2 size 0x78 — LPSPI
0x401A4000 LPI2C1 size 0x174 — LPI2C
0x401A8000 LPI2C2 size 0x174 — LPI2C
0x401AC000 FLEXIO1 size 0x7A0 — FLEXIO
0x401B8000 GPIO1 size 0x90 — GPIO
0x401CC000 PWM1 size 0x196 — PWM
0x401DC000 SPDIF size 0x54
0x401E0000 SAI1 size 0xE4 — SAI
0x401E8000 SAI3 size 0xE4 — SAI
0x401EC000 GPT1 size 0x28 — GPT
0x401F0000 GPT2 size 0x28 — GPT
0x401F4000 OCOTP size 0x6F4
0x401F8000 IOMUXC size 0x224
0x401FC000 KPP size 0x8 — KPP Registers
0x42000000 GPIO2 size 0x90 — GPIO
0xE000E000 SystemControl size 0xFAC — System Control Block
0xE000E100 NVIC size 0xE04 — Nested Vectored Interrupt Controller
0xE0080000 CM7_MCM size 0x1000

## Interrupts
{n} DMA{n} (DMA0, NVIC) (n=0..15)
16 DMA_ERROR (DMA0, NVIC)
17 CTI0_ERROR (NVIC)
18 CTI1_ERROR (NVIC)
19 CORE (NVIC)
20 LPUART1 (LPUART1, NVIC)
21 LPUART2 (LPUART2, NVIC)
22 LPUART3 (LPUART3, NVIC)
23 LPUART4 (LPUART4, NVIC)
24 PIT (PIT, NVIC)
25 USB_OTG1 (USB, NVIC)
26 FLEXSPI (FLEXSPI, NVIC)
27 FLEXRAM (FLEXRAM, NVIC)
28 LPI2C1 (LPI2C1, NVIC)
29 LPI2C2 (LPI2C2, NVIC)
30 GPT1 (GPT1, NVIC)
31 GPT2 (GPT2, NVIC)
32 LPSPI1 (LPSPI1, NVIC)
33 LPSPI2 (LPSPI2, NVIC)
34 PWM1_0 (PWM1, NVIC)
35 PWM1_1 (PWM1, NVIC)
36 PWM1_2 (PWM1, NVIC)
37 PWM1_3 (PWM1, NVIC)
38 PWM1_FAULT (PWM1, NVIC)
39 KPP (KPP, NVIC)
40 SRC (SRC, NVIC)
41 GPR_IRQ (NVIC)
42 CCM_1 (CCM, NVIC)
43 CCM_2 (CCM, NVIC)
44 EWM (EWM, NVIC)
45 WDOG2 (WDOG2, NVIC)
46 SNVS_HP_WRAPPER (SNVS, NVIC)
47 SNVS_HP_WRAPPER_TZ (SNVS, NVIC)
48 SNVS_LP_WRAPPER (SNVS, NVIC)
49 CSU (CSU, NVIC)
50 DCP (DCP, NVIC)
51 DCP_VMI (DCP, NVIC)
52 Reserved68 (NVIC)
53 TRNG (TRNG, NVIC)
54 Reserved70 (NVIC)
55 Reserved71 (NVIC)
56 SAI1 (SAI1, NVIC)
57 RTWDOG (RTWDOG, NVIC)
58 SAI3_RX (SAI3, NVIC)
59 SAI3_TX (SAI3, NVIC)
60 SPDIF (SPDIF, NVIC)
61 PMU (PMU, NVIC)
62 XBAR1_IRQ_0_1_2_3 (NVIC)
63 TEMP_LOW_HIGH (TEMPMON, NVIC)
64 TEMP_PANIC (TEMPMON, NVIC)
65 USB_PHY (USBPHY, NVIC)
66 GPC (GPC, NVIC)
67 ADC1 (ADC1, NVIC)
68 FLEXIO1 (FLEXIO1, NVIC)
69 DCDC (DCDC, NVIC)
70 GPIO1_Combined_0_15 (GPIO1, NVIC)
71 GPIO1_Combined_16_31 (GPIO1, NVIC)
72 GPIO2_Combined_0_15 (GPIO2, NVIC)
73 GPIO5_Combined_0_15 (GPIO5, NVIC)
74 WDOG1 (WDOG1, NVIC)
75 ADC_ETC_IRQ0 (ADC_ETC, NVIC)
76 ADC_ETC_IRQ1 (ADC_ETC, NVIC)
77 ADC_ETC_IRQ2 (ADC_ETC, NVIC)
78 ADC_ETC_IRQ3 (ADC_ETC, NVIC)
79 ADC_ETC_ERROR_IRQ (ADC_ETC, NVIC)

## Licence text in the file
Copyright 2016-2021 NXP All rights reserved. SPDX-License-Identifier: BSD-3-Clause
