# MIMXRT1011 register map
Vendor: nxp.com; File version: 1.0
CPU: CM7 r0p1, little endian, MPU, FPU, VTOR, 4 interrupt priority bits
Registers are 32-bit, read-write, reset 0x0 unless marked. A register's access mark holds for its fields unless they carry their own. Offsets are from the block's base; [hi:lo] are bit positions; {n}, {i} and the like mark numbered series.

## NVIC — Nested Vectored Interrupt Controller
Base 0xE000E100
{0x0+4i} NVICISER{i} (i=0..3) — Interrupt Set Enable Register n
  [31:0] SETENA write-1-clears — Interrupt set enable bits
{0x80+4i} NVICICER{i} (i=0..3) — Interrupt Clear Enable Register n
  [31:0] CLRENA write-1-clears — Interrupt clear-enable bits
{0x100+4i} NVICISPR{i} (i=0..3) — Interrupt Set Pending Register n
  [31:0] SETPEND write-1-clears — Interrupt set-pending bits
{0x180+4i} NVICICPR{i} (i=0..3) — Interrupt Clear Pending Register n
  [31:0] CLRPEND write-1-clears — Interrupt clear-pending bits
{0x200+4i} NVICIABR{i} (i=0..3) — Interrupt Active bit Register n
  [31:0] ACTIVE — Interrupt active flags
{0x300+i} NVICIP{i} 8-bit (i=0..15) — Interrupt Priority Register {i}
  [7:4] PRI{i} — Priority of the INT_DMA{i} interrupt {i}
0x310 NVICIP16 8-bit — Interrupt Priority Register 16
  [7:4] PRI16 — Priority of the INT_DMA_ERROR interrupt 16
0x311 NVICIP17 8-bit — Interrupt Priority Register 17
  [7:4] PRI17 — Priority of the INT_CTI0_ERROR interrupt 17
0x312 NVICIP18 8-bit — Interrupt Priority Register 18
  [7:4] PRI18 — Priority of the INT_CTI1_ERROR interrupt 18
0x313 NVICIP19 8-bit — Interrupt Priority Register 19
  [7:4] PRI19 — Priority of the INT_CORE interrupt 19
{0x300+i} NVICIP{i} 8-bit (i=20..23) — Interrupt Priority Register {i}
  [7:4] PRI{i} — Priority of the INT_LPUART{i-19} interrupt {i}
0x318 NVICIP24 8-bit — Interrupt Priority Register 24
  [7:4] PRI24 — Priority of the INT_PIT interrupt 24
0x319 NVICIP25 8-bit — Interrupt Priority Register 25
  [7:4] PRI25 — Priority of the INT_USB_OTG1 interrupt 25
0x31A NVICIP26 8-bit — Interrupt Priority Register 26
  [7:4] PRI26 — Priority of the INT_FLEXSPI interrupt 26
0x31B NVICIP27 8-bit — Interrupt Priority Register 27
  [7:4] PRI27 — Priority of the INT_FLEXRAM interrupt 27
0x31C NVICIP28 8-bit — Interrupt Priority Register 28
  [7:4] PRI28 — Priority of the INT_LPI2C1 interrupt 28
0x31D NVICIP29 8-bit — Interrupt Priority Register 29
  [7:4] PRI29 — Priority of the INT_LPI2C2 interrupt 29
0x31E NVICIP30 8-bit — Interrupt Priority Register 30
  [7:4] PRI30 — Priority of the INT_GPT1 interrupt 30
0x31F NVICIP31 8-bit — Interrupt Priority Register 31
  [7:4] PRI31 — Priority of the INT_GPT2 interrupt 31
0x320 NVICIP32 8-bit — Interrupt Priority Register 32
  [7:4] PRI32 — Priority of the INT_LPSPI1 interrupt 32
0x321 NVICIP33 8-bit — Interrupt Priority Register 33
  [7:4] PRI33 — Priority of the INT_LPSPI2 interrupt 33
{0x300+i} NVICIP{i} 8-bit (i=34..37) — Interrupt Priority Register {i}
  [7:4] PRI{i} — Priority of the INT_PWM1_{i-34} interrupt {i}
0x326 NVICIP38 8-bit — Interrupt Priority Register 38
  [7:4] PRI38 — Priority of the INT_PWM1_FAULT interrupt 38
0x327 NVICIP39 8-bit — Interrupt Priority Register 39
  [7:4] PRI39 — Priority of the INT_KPP interrupt 39
0x328 NVICIP40 8-bit — Interrupt Priority Register 40
  [7:4] PRI40 — Priority of the INT_SRC interrupt 40
0x329 NVICIP41 8-bit — Interrupt Priority Register 41
  [7:4] PRI41 — Priority of the INT_GPR_IRQ interrupt 41
0x32A NVICIP42 8-bit — Interrupt Priority Register 42
  [7:4] PRI42 — Priority of the INT_CCM_1 interrupt 42
0x32B NVICIP43 8-bit — Interrupt Priority Register 43
  [7:4] PRI43 — Priority of the INT_CCM_2 interrupt 43
0x32C NVICIP44 8-bit — Interrupt Priority Register 44
  [7:4] PRI44 — Priority of the INT_EWM interrupt 44
0x32D NVICIP45 8-bit — Interrupt Priority Register 45
  [7:4] PRI45 — Priority of the INT_WDOG2 interrupt 45
0x32E NVICIP46 8-bit — Interrupt Priority Register 46
  [7:4] PRI46 — Priority of the INT_SNVS_HP_WRAPPER interrupt 46
0x32F NVICIP47 8-bit — Interrupt Priority Register 47
  [7:4] PRI47 — Priority of the INT_SNVS_HP_WRAPPER_TZ interrupt 47
0x330 NVICIP48 8-bit — Interrupt Priority Register 48
  [7:4] PRI48 — Priority of the INT_SNVS_LP_WRAPPER interrupt 48
0x331 NVICIP49 8-bit — Interrupt Priority Register 49
  [7:4] PRI49 — Priority of the INT_CSU interrupt 49
0x332 NVICIP50 8-bit — Interrupt Priority Register 50
  [7:4] PRI50 — Priority of the INT_DCP interrupt 50
0x333 NVICIP51 8-bit — Interrupt Priority Register 51
  [7:4] PRI51 — Priority of the INT_DCP_VMI interrupt 51
0x334 NVICIP52 8-bit — Interrupt Priority Register 52
  [7:4] PRI52 — Priority of the INT_Reserved68 interrupt 52
0x335 NVICIP53 8-bit — Interrupt Priority Register 53
  [7:4] PRI53 — Priority of the INT_TRNG interrupt 53
0x336 NVICIP54 8-bit — Interrupt Priority Register 54
  [7:4] PRI54 — Priority of the INT_Reserved70 interrupt 54
0x337 NVICIP55 8-bit — Interrupt Priority Register 55
  [7:4] PRI55 — Priority of the INT_Reserved71 interrupt 55
0x338 NVICIP56 8-bit — Interrupt Priority Register 56
  [7:4] PRI56 — Priority of the INT_SAI1 interrupt 56
0x339 NVICIP57 8-bit — Interrupt Priority Register 57
  [7:4] PRI57 — Priority of the INT_RTWDOG interrupt 57
0x33A NVICIP58 8-bit — Interrupt Priority Register 58
  [7:4] PRI58 — Priority of the INT_SAI3_RX interrupt 58
0x33B NVICIP59 8-bit — Interrupt Priority Register 59
  [7:4] PRI59 — Priority of the INT_SAI3_TX interrupt 59
0x33C NVICIP60 8-bit — Interrupt Priority Register 60
  [7:4] PRI60 — Priority of the INT_SPDIF interrupt 60
0x33D NVICIP61 8-bit — Interrupt Priority Register 61
  [7:4] PRI61 — Priority of the INT_PMU interrupt 61
0x33E NVICIP62 8-bit — Interrupt Priority Register 62
  [7:4] PRI62 — Priority of the INT_XBAR1_IRQ_0_1_2_3 interrupt 62
0x33F NVICIP63 8-bit — Interrupt Priority Register 63
  [7:4] PRI63 — Priority of the INT_TEMP_LOW_HIGH interrupt 63
0x340 NVICIP64 8-bit — Interrupt Priority Register 64
  [7:4] PRI64 — Priority of the INT_TEMP_PANIC interrupt 64
0x341 NVICIP65 8-bit — Interrupt Priority Register 65
  [7:4] PRI65 — Priority of the INT_USB_PHY interrupt 65
0x342 NVICIP66 8-bit — Interrupt Priority Register 66
  [7:4] PRI66 — Priority of the INT_GPC interrupt 66
0x343 NVICIP67 8-bit — Interrupt Priority Register 67
  [7:4] PRI67 — Priority of the INT_ADC1 interrupt 67
0x344 NVICIP68 8-bit — Interrupt Priority Register 68
  [7:4] PRI68 — Priority of the INT_FLEXIO1 interrupt 68
0x345 NVICIP69 8-bit — Interrupt Priority Register 69
  [7:4] PRI69 — Priority of the INT_DCDC interrupt 69
0x346 NVICIP70 8-bit — Interrupt Priority Register 70
  [7:4] PRI70 — Priority of the INT_GPIO1_Combined_0_15 interrupt 70
0x347 NVICIP71 8-bit — Interrupt Priority Register 71
  [7:4] PRI71 — Priority of the INT_GPIO1_Combined_16_31 interrupt 71
0x348 NVICIP72 8-bit — Interrupt Priority Register 72
  [7:4] PRI72 — Priority of the INT_GPIO2_Combined_0_15 interrupt 72
0x349 NVICIP73 8-bit — Interrupt Priority Register 73
  [7:4] PRI73 — Priority of the INT_GPIO5_Combined_0_15 interrupt 73
0x34A NVICIP74 8-bit — Interrupt Priority Register 74
  [7:4] PRI74 — Priority of the INT_WDOG1 interrupt 74
{0x300+i} NVICIP{i} 8-bit (i=75..78) — Interrupt Priority Register {i}
  [7:4] PRI{i} — Priority of the INT_ADC_ETC_IRQ{i-75} interrupt {i}
0x34F NVICIP79 8-bit — Interrupt Priority Register 79
  [7:4] PRI79 — Priority of the INT_ADC_ETC_ERROR_IRQ interrupt 79
0xE00 NVICSTIR — Software Trigger Interrupt Register
  [8:0] INTID — Interrupt ID of the interrupt to trigger, in the range 0-239. For example, a value of 0x03 specifies interrupt IRQ3.
